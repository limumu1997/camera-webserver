#pragma once

#include "driver/i2c_master.h"
#include <string.h>

#define OLED_I2C_PORT         I2C_NUM_0
#define OLED_SDA_PIN          GPIO_NUM_1
#define OLED_SCL_PIN          GPIO_NUM_2
#define OLED_I2C_ADDR         0x3C       // 0.96寸 OLED 默认 I2C 地址

// 新版 I2C 设备句柄
static i2c_master_dev_handle_t oled_dev_handle = NULL;

// 基础 8x8 字符点阵字模 (支持常用 ASCII 可打印字符 0x20 至 0x7F)
static const uint8_t font8x8[][8] = {
    {0x00,0x00,0x00,0x00,0x00,0x00,0x00,0x00}, // (space) 0x20
    {0x00,0x00,0x5F,0x00,0x00,0x00,0x00,0x00}, // !
    {0x00,0x07,0x00,0x07,0x00,0x00,0x00,0x00}, // "
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    {0x08,0x08,0x2A,0x1C,0x08,0x00,0x00,0x00}  // ~ 0x7E
};

// 采用新版 I2C 主机驱动发送指令
static void oled_write_cmd(uint8_t cmd) {
    if (oled_dev_handle == NULL) return;
    uint8_t buf[2] = {0x00, cmd};
    i2c_master_transmit(oled_dev_handle, buf, 2, 100);
}

// 采用新版 I2C 主机驱动发送显示数据 (1 字节控制前缀 0x40 + N 字节数据)
static void oled_write_data(const uint8_t *data, size_t len) {
    if (oled_dev_handle == NULL) return;
    if (len > 128) len = 128;
    
    uint8_t buf[129];
    buf[0] = 0x40; // Data control prefix
    memcpy(&buf[1], data, len);
    i2c_master_transmit(oled_dev_handle, buf, len + 1, 100);
}

// 使用 ESP-IDF 6.0 推荐的全新 i2c_master 接口初始化
static esp_err_t oled_init(void) {
    // 1. 配置 I2C 主控总线
    i2c_master_bus_config_t bus_config = {};
    bus_config.i2c_port = OLED_I2C_PORT; // I2C_NUM_1
    bus_config.sda_io_num = OLED_SDA_PIN; // GPIO_NUM_1
    bus_config.scl_io_num = OLED_SCL_PIN; // GPIO_NUM_2
    bus_config.clk_source = I2C_CLK_SRC_DEFAULT;
    bus_config.flags.enable_internal_pullup = true;

    i2c_master_bus_handle_t bus_handle;
    esp_err_t err = i2c_new_master_bus(&bus_config, &bus_handle);
    if (err != ESP_OK) return err;

    // 2. 将 SSD1306 挂载为总线上的一个 I2C 从机设备
    i2c_device_config_t dev_config = {};
    dev_config.dev_addr_length = I2C_ADDR_BIT_LEN_7;
    dev_config.device_address = OLED_I2C_ADDR; // 0x3C
    dev_config.scl_speed_hz = 400000;          // 400KHz 快速模式

    err = i2c_master_bus_add_device(bus_handle, &dev_config, &oled_dev_handle);
    if (err != ESP_OK) return err;

    // 3. SSD1306 屏幕底层控制序列初始化
    oled_write_cmd(0xAE); // Turn display off
    oled_write_cmd(0xD5); // Set display clock divide ratio/oscillator frequency
    oled_write_cmd(0x80);
    oled_write_cmd(0xA8); // Set multiplex ratio
    oled_write_cmd(0x3F); // 64MUX
    oled_write_cmd(0xD3); // Set display offset
    oled_write_cmd(0x00);
    oled_write_cmd(0x40); // Set display start line
    oled_write_cmd(0x8D); // Charge pump
    oled_write_cmd(0x14); // Enable charge pump
    oled_write_cmd(0x20); // Set Memory Addressing Mode
    oled_write_cmd(0x02); // Page Addressing Mode (非常适合写字符)
    oled_write_cmd(0xA1); // Set Segment Re-map
    oled_write_cmd(0xC8); // Set COM Output Scan Direction
    oled_write_cmd(0xDA); // Set COM Pins Hardware Configuration
    oled_write_cmd(0x12);
    oled_write_cmd(0x81); // Contrast control
    oled_write_cmd(0xCF);
    oled_write_cmd(0xD9); // Set pre-charge period
    oled_write_cmd(0xF1);
    oled_write_cmd(0xDB); // Set VCOMH Deselect Level
    oled_write_cmd(0x40);
    oled_write_cmd(0xA4); // Entire display on (Resume to RAM content)
    oled_write_cmd(0xA6); // Normal display
    oled_write_cmd(0xAF); // Turn display on

    return ESP_OK;
}

// 快速清除屏幕所有像素 (写 0x00)
static void oled_clear(void) {
    uint8_t zero[128] = {0};
    for (uint8_t i = 0; i < 8; i++) {
        oled_write_cmd(0xB0 + i); // 设置 Page
        oled_write_cmd(0x00);     // 设置列低位
        oled_write_cmd(0x10);     // 设置列高位
        oled_write_data(zero, 128);
    }
}

// 在屏幕特定 Page (0-7行) 和列 (0-127像素) 绘制一个 8x8 字符
static void oled_draw_char(uint8_t page, uint8_t col, char c) {
    if (page > 7 || col > 120) return;
    uint8_t idx = 0;
    if (c >= 0x20 && c <= 0x7E) {
        idx = c - 0x20;
    }
    oled_write_cmd(0xB0 + page);
    oled_write_cmd(0x00 + (col & 0x0F));
    oled_write_cmd(0x10 + ((col >> 4) & 0x0F));
    oled_write_data(font8x8[idx], 8);
}

// 在屏幕特定 Page 打印一串 ASCII 字符串
static void oled_draw_string(uint8_t page, uint8_t col, const char *str) {
    while (*str) {
        oled_draw_char(page, col, *str);
        col += 8; // 一个字符占 8 像素宽
        str++;
        if (col > 120) { // 自动换行
            col = 0;
            page++;
            if (page > 7) break;
        }
    }
}
